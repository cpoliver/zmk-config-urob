/* source key position labels */
#include "zmk-helpers/key-labels/42.h"

/* activate bluetooth */
#define CONFIG_WIRELESS

/* source the main keymap */
#include "base.keymap"

/* use 5-column layout for Zen */
/* /{ chosen { zmk,physical-layout = &foostan_corne_6col_layout; }; }; */
