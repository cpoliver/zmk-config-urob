#include <behaviors.dtsi>
#include <behaviors/num_word.dtsi> // requires auto-layer module
#include <dt-bindings/zmk/keys.h>
#include <dt-bindings/zmk/bt.h>

#include "zmk-helpers/helper.h"

/* Aliases */

// layer aliases
#define DEF 0
#define NAV 1
#define NUM 2
#define FUN 3
#define SYS 4
#define MSE 5

// utility aliases
#define XXX &none
#define ___ &trans

// mouse aliases (prefix with _ to allow formatting with codethread/qmk vim plugin)
#define _MW_L U_WH_L
#define _MW_D U_WH_D
#define _MS_U U_MS_U
#define _MW_U U_WH_U
#define _MW_R U_WH_R
#define _MS_L U_MS_L
#define _MS_D U_MS_D
#define _MS_R U_MS_R
#define _MB1 &mkp LCLK
#define _MB2 &mkp RCLK
#define _MB3 &mkp MCLK

// bluetooth aliases
#define _BT1 &bt BT_SEL 0
#define _BT2 &bt BT_SEL 1
#define _BT3 &bt BT_SEL 2
#define _BT4 &bt BT_SEL 3
#define _BT5 &bt BT_SEL 4
#define _BT6 &bt BT_SEL 5
#define _BTC &bt BT_CLR

// misc aliases
#define _CANCEL      &kp K_CANCEL             // cancel caps-word, num-word and smart-mouse
#define _DSK_PREV    &hmr LCTRL LG(LC(LEFT))  // previous desktop
#define _DSK_NEXT    &hmr LALT LG(LC(RIGHT))  // next     desktop
#define _PIN_WIN     &kp LG(LC(LS(Q)))        // pin window across desktops
#define _PIN_APP     &kp LG(LC(LS(A)))        // pin application across desktops
#define _DSK_MGR     &kp LA(GRAVE)            // desktop manager
#define _VOL_DOWN    &hmr RSHFT C_VOL_DN

/* Behaviors */

#define QUICK_TAP_MS 175

// sticky key
&sk {
    release-after-ms = <900>;  // release after 0.9s
    quick-release;             // no double capitalization when rolling keys
};

// sticky layer
&sl {
    ignore-modifiers;          // allow chording sticky mods & layers
};

// layer-tap
&lt {
    flavor = "balanced";
    tapping-term-ms = <200>;
    quick-tap-ms = <QUICK_TAP_MS>;
};

/* Homerow mods */

#define KEYS_L LT0 LT1 LT2 LT3 LT4 LT5 LM0 LM1 LM2 LM3 LM4 LM5 LB0 LB1 LB2 LB3 LB4 LB5
#define KEYS_R RT0 RT1 RT2 RT3 RT4 RT5 RM0 RM1 RM2 RM3 RM4 RM5 RB0 RB1 RB2 RB3 RB4 RB5
#define THUMBS LH2 LH1 LH0 RH0 RH1 RH2

#define MAKE_HRM(NAME, HOLD, TAP, TRIGGER_POS) \
    ZMK_HOLD_TAP(NAME, \
        flavor = "balanced"; \
        tapping-term-ms = <280>; \
        quick-tap-ms = <QUICK_TAP_MS>; \
        require-prior-idle-ms = <150>; \
        bindings = <HOLD>, <TAP>; \
        hold-trigger-key-positions = <TRIGGER_POS>; \
        hold-trigger-on-release; \
    )
MAKE_HRM(hml, &kp, &kp, KEYS_R THUMBS)  // left-hand HRMs
MAKE_HRM(hmr, &kp, &kp, KEYS_L THUMBS)  // right-hand HRMs

// HRM combo hack - workaround for lack of tap-only combos (ZMK issue #544)
#define ZMK_COMBO_8(NAME, TAP, KEYPOS, LAYERS, COMBO_TERM, COMBO_IDLE, HOLD, SIDE) \
    MAKE_HRM(hm_combo_ ## NAME, &kp, TAP, SIDE THUMBS) \
    ZMK_COMBO_6(NAME, &hm_combo_ ## NAME HOLD 0, KEYPOS, LAYERS, COMBO_TERM, COMBO_IDLE)

/* Combos, mouse emulation */

#include "combos.dtsi"  // must be sourced after HRM-combo hack
#include "mouse.dtsi"

/* Nav cluster */

// long-tap action on hold, short-tap action on all interrupts
#define MT_CORE \
    flavor = "tap-preferred"; \
    tapping-term-ms = <220>; \
    quick-tap-ms = <220>; \
    hold-trigger-key-positions = <0>;

&mt { MT_CORE };
ZMK_HOLD_TAP(mt_home, bindings = <&masked_home>, <&kp>; MT_CORE)
ZMK_HOLD_TAP(mt_end, bindings = <&masked_end>, <&kp>; MT_CORE)

#define _NAV_LEFT  &mt_home 0   LEFT    // tap: left  | long-tap: beginning of line
#define _NAV_RIGHT &mt_end 0    RIGHT   // tap: right | long-tap: end       of line
#define _NAV_UP    &mt LC(HOME) UP      // tap: up    | long-tap: beginning of document
#define _NAV_DOWN  &mt LC(END)  DOWN    // tap: down  | long-tap: end       of document
#define _NAV_BSPC  &mt LC(BSPC) BSPC    // tap: bspc  | long-tap: delete word backward
#define _NAV_DEL   &mt LC(DEL)  DEL     // tap: del   | long-tap: delete word forward

// mask CTRL when holding left/right to avoid accidental jumps to beginning/end of document
#define MASK_MODS(NAME, MODS, BINDING) \
    ZMK_MOD_MORPH(NAME, \
        bindings = <BINDING>, <BINDING>; \
        mods = <MODS>; \
    )
MASK_MODS(masked_home, (MOD_LCTL), &kp HOME)
MASK_MODS(masked_end,  (MOD_LCTL), &kp END)

/* Caps-word, num-word and smart-mouse */

// tap: sticky-shift | shift + tap/ double-tap: caps-word | hold: shift
ZMK_MOD_MORPH(smart_shft,
    bindings = <&sk LSHFT>, <&caps_word>;
    mods = <(MOD_LSFT)>;
)
&caps_word {  // mods deactivate caps-word, requires PR #1451
    /delete-property/ ignore-modifiers;
};

// tap: num-word | double-tap: sticky num-layer | hold: num-layer
// #define SMART_NUM &smart_num NUM 0
// ZMK_HOLD_TAP(smart_num,
//     flavor = "balanced";
//     tapping-term-ms = <200>;
//     quick-tap-ms = <QUICK_TAP_MS>;
//     bindings = <&mo>, <&num_dance>;
// )
// ZMK_TAP_DANCE(num_dance,
//     tapping-term-ms = <200>;
//     bindings = <&num_word NUM>, <&sl NUM>;  // reverse this for sticky-num on single tap
// )

// smart-mouse, requires PR #1366
// ZMK_TRI_STATE(smart_mouse,
//     bindings = <&tog MSE>, <&none>, <&tog MSE>;
//     ignored-key-positions = <LT1 LT3 RT0 RT1 RT2 RT3 RT4 RM1 RM2 RM3 RB1 RB2 RB3 RH0 RH1>;
//     ignored-layers = <MSE>;
// )

/* Custom behaviors */

// Alt+Tab swapper, requires PR #1366
ZMK_TRI_STATE(swapper,
    bindings = <&kt LALT>, <&kp TAB>, <&kt LALT>;
    ignored-key-positions = <LT2>;
)

// reuse basic mod-morph scheme
#define SIMPLE_MORPH(NAME, MOD, BINDING1, BINDING2) \
    ZMK_MOD_MORPH(NAME, \
        mods = <(MOD_L ## MOD|MOD_R ## MOD)>; \
        bindings = <BINDING1>, <BINDING2>; \
    )

// tap: comma | shift + tap: semicolon | ctrl + shift + tap: <
SIMPLE_MORPH(comma_morph, SFT, &kp COMMA, &comma_inner_morph)
SIMPLE_MORPH(comma_inner_morph, CTL, &kp SEMICOLON, &kp LESS_THAN)

// tap: dot | shift + tap: colon | ctrl + shift + tap: >
SIMPLE_MORPH(dot_morph, SFT, &kp DOT, &dot_inner_morph)
SIMPLE_MORPH(dot_inner_morph, CTL, &kp COLON, &kp GREATER_THAN)

// tap: qmark | shift + tap: excl
SIMPLE_MORPH(qexcl, SFT, &kp QMARK, &kp EXCL)

// tap: left/right parenthesis | shft + tap: less-than/greater-than
SIMPLE_MORPH(lpar_lt, SFT, &kp LPAR, &kp LT)
SIMPLE_MORPH(rpar_gt, SFT, &kp RPAR, &kp GT)

// // tap: space | shift + tap: dot -> space -> sticky shift | hold: activate layer
// ZMK_HOLD_TAP(lt_spc,
//     flavor = "balanced";
//     tapping-term-ms = <200>;
//     quick-tap-ms = <QUICK_TAP_MS>;
//     bindings = <&mo>, <&spc_morph>;
// )
// SIMPLE_MORPH(spc_morph, SFT, &kp SPACE, &dot_spc)
// ZMK_MACRO(dot_spc,
//     wait-ms = <0>;
//     tap-ms = <5>;
//     bindings = <&kp DOT &kp SPACE &sk LSHFT>;
// )
//
// // tap: backspace | lshft + tap: delete | rshft + tap: shift-delete
// ZMK_MOD_MORPH(bs_del,
//     bindings = <&kp BSPC>, <&kp DEL>;
//     mods = <(MOD_LSFT|MOD_RSFT)>;
//     keep-mods = <MOD_RSFT>;
// )
//
// // tap: copy | double-tap: cut
// ZMK_TAP_DANCE(copy_cut,
//     tapping-term-ms = <200>;
//     bindings = <&kp LC(INS)>, <&kp LC(X)>;
// )

/* vim: set ft=c tw=174: */
